## conf/layer.conf
```bitbake
# We have a conf and classes directory, add to BBPATH
BBPATH .= ":${LAYERDIR}"

# We have a packages directory, add to BBFILES
BBFILES += "${LAYERDIR}/recipes-*/*/*.bb"
BBFILES += "${LAYERDIR}/recipes-*/*/*.bbappend"

BBFILE_COLLECTIONS += "mainlinecommon-layer"
BBFILE_PATTERN_mainlinecommon-layer = "^${LAYERDIR}/"
BBFILE_PRIORITY_mainlinecommon-layer = "5"

LAYERDEPENDS_mainlinecommon-layer = "core"
LAYERSERIES_COMPAT_mainlinecommon-layer = "zeus dunfell"
```
